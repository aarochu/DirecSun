## firmware/components/direcsun_comms/Kconfig
```kconfig
menu "DirecSun network"

    config DIRECSUN_WIFI_SOFTAP
        bool "Run a SoftAP instead of joining a network"
        default n
        help
            Fallback (FD section 15.1): the box runs its own access point and
            serves ws://192.168.4.1/ws, the main UI's default endpoint. Chosen at
            build time only; the box never switches modes on its own.

    config DIRECSUN_WIFI_SSID
        string "Wi-Fi network name (station mode)"
        default ""
        depends on !DIRECSUN_WIFI_SOFTAP
        help
            Set it in firmware/sdkconfig.defaults.local (gitignored), never in a
            tracked file. With an empty name the box stays offline and logs why.

    config DIRECSUN_WIFI_PASSWORD
        string "Wi-Fi password (station mode)"
        default ""
        depends on !DIRECSUN_WIFI_SOFTAP

    config DIRECSUN_WIFI_STATIC_IP
        bool "Static address instead of DHCP (station mode)"
        default n
        depends on !DIRECSUN_WIFI_SOFTAP
        help
            For a network without DHCP, or a fixed address on the OM5P-AC radio.

    config DIRECSUN_WIFI_IP
        string "Static address"
        default "10.0.0.120"
        depends on DIRECSUN_WIFI_STATIC_IP

    config DIRECSUN_WIFI_GATEWAY
        string "Gateway"
        default "10.0.0.1"
        depends on DIRECSUN_WIFI_STATIC_IP

    config DIRECSUN_WIFI_NETMASK
        string "Netmask"
        default "255.255.255.0"
        depends on DIRECSUN_WIFI_STATIC_IP

    config DIRECSUN_SOFTAP_SSID
        string "SoftAP network name"
        default "DirecSun"
        depends on DIRECSUN_WIFI_SOFTAP

    config DIRECSUN_SOFTAP_PASSWORD
        string "SoftAP password (8 or more characters; empty for an open network)"
        default ""
        depends on DIRECSUN_WIFI_SOFTAP

    config DIRECSUN_SOFTAP_CHANNEL
        int "SoftAP channel"
        default 6
        range 1 13
        depends on DIRECSUN_WIFI_SOFTAP

    config DIRECSUN_HOSTNAME
        string "mDNS hostname"
        default "direcsun"
        help
            The box answers at ws://<hostname>.local/ws.

endmenu
```

## firmware/main/Kconfig.projbuild
```kconfig
menu "DirecSun bench options"

    config DIRECSUN_BENCH_STALL_TEST
        bool "Control-stall watchdog test hook (bench builds only)"
        default n
        help
            Bench check BC-5 (changes/3-teleop/R3.4-control-task.md): blocks the
            control task once, DIRECSUN_BENCH_STALL_AFTER_S seconds after it
            starts, for DIRECSUN_BENCH_STALL_MS milliseconds. The stall watchdog
            must reset the board within 100 ms. Never enable this in a flight
            build; firmware/sdkconfig.bench turns it on for the bench build only.

    config DIRECSUN_BENCH_STALL_AFTER_S
        int "Seconds after the control task starts"
        depends on DIRECSUN_BENCH_STALL_TEST
        default 10
        range 2 600

    config DIRECSUN_BENCH_STALL_MS
        int "Block duration in milliseconds"
        depends on DIRECSUN_BENCH_STALL_TEST
        default 200
        range 120 2000

    config DIRECSUN_BENCH_STAGE_TIMING
        bool "Per-stage control tick timing (bench diagnostic)"
        default n
        help
            Bench diagnostic for the control tick budget (R3.4): measures the
            longest time each stage of the tick took in every second (IMU burst,
            magnetometer poll, ADC read, Hall drain, estimator, supervisor,
            DShot frame, outbound queues, telemetry snapshot) and has the status
            task print one "stages" line per second. Adds a few esp_timer reads
            per tick; leave it off in flight builds. firmware/sdkconfig.diag
            turns it on.

endmenu
```
